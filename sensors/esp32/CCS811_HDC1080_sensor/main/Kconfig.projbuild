## sensors/esp32/CCS811_HDC1080_sensor/main/Kconfig.projbuild
```kconfig
menu "Example Configuration"

    menu "I2C Master"
        config I2C_MASTER_SCL
            int "SCL GPIO Num"
            default 22
            help
                GPIO number for I2C Master clock line.

        config I2C_MASTER_SDA
            int "SDA GPIO Num"
            default 21
            help
                GPIO number for I2C Master data line.

        config I2C_MASTER_PORT_NUM
            int "Port Number"
            default 1
            help
                Port number for I2C Master device.

        config I2C_MASTER_FREQUENCY
            int "Master Frequency"
            default 100000
            help
                I2C Speed of Master device.
    endmenu

    menu "I2C Slave"
        config I2C_SLAVE_ADDRESS_CCS811
            hex "ESP Slave Address"
            default 0x5A
            help
                Hardware Address of I2C Slave Port.
    endmenu
endmenu
```
